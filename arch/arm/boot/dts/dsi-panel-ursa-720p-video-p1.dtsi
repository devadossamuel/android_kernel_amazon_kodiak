/* Copyright (c) 2012-2013, The Linux Foundation. All rights reserved.
 *
 * This program is free software; you can redistribute it and/or modify
 * it under the terms of the GNU General Public License version 2 and
 * only version 2 as published by the Free Software Foundation.
 *
 * This program is distributed in the hope that it will be useful,
 * but WITHOUT ANY WARRANTY; without even the implied warranty of
 * MERCHANTABILITY or FITNESS FOR A PARTICULAR PURPOSE.  See the
 * GNU General Public License for more details.
 */

/ {

	qcom,mdss_dsi_ursa_720p_video_p1 {
		compatible = "qcom,mdss-dsi-panel";
		label = "ursa p1 720p video mode dsi panel";
		status = "disable";
		qcom,dsi-ctrl-phandle = <&mdss_dsi0>;
		qcom,enable-gpio = <&msmgpio 58 0>;
		qcom,rst-gpio = <&pm8941_gpios 19 0>;
		qcom,touch-rst-gpio = <&msmgpio 60 0>;
		qcom,mdss-pan-res = <720 1280>;
		qcom,mdss-pan-bpp = <24>;
		qcom,mdss-pan-dest = "display_1";
		/* HBP, HS, HFP, VBP, VS, VFP */
		qcom,mdss-pan-porch-values = <32 16 136 3 1 3>;
		qcom,mdss-pan-underflow-clr = <0xff>;
		qcom,mdss-pan-bl-ctrl = "bl_ctrl_wled";
		qcom,mdss-pan-bl-levels = <1 4095>;
		qcom,mdss-pan-dsi-mode = <0>;
		qcom,mdss-pan-dsi-h-pulse-mode = <0>;
		qcom,mdss-pan-dsi-h-power-stop = <0 1 0>;
		qcom,mdss-pan-dsi-bllp-power-stop = <1 1>;
		qcom,mdss-pan-dsi-traffic-mode = <1>;
		qcom,mdss-pan-dsi-dst-format = <3>;
		qcom,mdss-pan-dsi-vc = <0>;
		qcom,mdss-pan-dsi-rgb-swap = <0>;
		qcom,mdss-pan-dsi-data-lanes = <1 1 1 1>;
		qcom,mdss-pan-dsi-dlane-swap = <0>;
		qcom,mdss-pan-dsi-t-clk = <0x15 0x01>; /* T_CLK_PRE, POST */
		qcom,mdss-pan-dsi-stream = <0>;
		qcom,mdss-pan-dsi-mdp-tr = <0x0>;
		qcom,mdss-pan-dsi-dma-tr = <0x04>;
		qcom,mdss-pan-frame-rate = <60>;
		qcom,panel-phy-regulatorSettings = [03 01 01 00  /* Regulator settings, DSI_BASE+0x580-587 */
						    20 00 01]; /* Using the same settings as CDP for now */
		qcom,panel-phy-timingSettings = //243 MHz (486 Mbps) DSI clock settings
					[
						88  //DSIPHY_TIMING_CTRL_0 (0x260)
						1F  //DSIPHY_TIMING_CTRL_1 (0x264)
						14  //DSIPHY_TIMING_CTRL_2 (0x268)
						00  // 3
						44  //DSIPHY_TIMING_CTRL_4 (0x270)
						49  //DSIPHY_TIMING_CTRL_5 (0x274)
						19  //DSIPHY_TIMING_CTRL_6 (0x278)
						22  //DSIPHY_TIMING_CTRL_7 (0x27C)
						23  //DSIPHY_TIMING_CTRL_8 (0x280)
						03  //DSIPHY_TIMING_CTRL_9 (0x284)
						04  //DSIPHY_TIMING_CTRL_10 (0x288)
						00  //11
					];
		qcom,panel-phy-strengthCtrl = [77 06]; /* left unchanged from CDP */
		qcom,panel-phy-bistCtrl = [00 00 b1 ff           /* BIST Ctrl settings */
					   00 00];
		qcom,panel-phy-laneConfig = [00 c2 45 00 00 00 00 01 75 /* lane0 config */
					     00 c2 45 00 00 00 00 01 75 /* lane1 config */
					     00 c2 45 00 00 00 00 01 75 /* lane2 config */
					     00 c2 45 00 00 00 00 01 75 /* lane3 config */
					     00 02 45 00 00 00 00 01 97]; /* Clk ln config */

		qcom,panel-on-cmds = [05 01 00 00 78 02 11 00 /*exit sleep*/
					23 01 00 00 0a 02 b0 00 /*mcap off */
					29 01 00 00 00 04
						FF 12 82 01
					23 01 00 00 0a 02 00 80 /* ADRSFT */
					29 01 00 00 00 03
						FF 12 82
					23 01 00 00 0a 02 00 00 /* ADRSFT */
					23 01 00 00 0a 02 1C 32 /* RAMZIP_VDO_SET */
					23 01 00 00 0a 02 00 A0 /* ADRSFT */
					29 01 00 00 00 04  /*VIDEO_SYNC */
						C1 E0 E0 10
					05 01 00 00 32 02 29 00 /* display on */
					];
		qcom,on-cmds-dsi-state = "DSI_LP_MODE";
		qcom,panel-off-cmds = [05 01 00 00 32 02 28 00
					05 01 00 00 78 02 10 00];
		qcom,off-cmds-dsi-state = "DSI_HS_MODE";
	};
};
