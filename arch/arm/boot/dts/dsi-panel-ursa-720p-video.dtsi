/* Copyright (c) 2012-2013, The Linux Foundation. All rights reserved.
 *
 * This program is free software; you can redistribute it and/or modify
 * it under the terms of the GNU General Public License version 2 and
 * only version 2 as published by the Free Software Foundation.
 *
 * This program is distributed in the hope that it will be useful,
 * but WITHOUT ANY WARRANTY; without even the implied warranty of
 * MERCHANTABILITY or FITNESS FOR A PARTICULAR PURPOSE.  See the
 * GNU General Public License for more details.
 */

/ {

	qcom,mdss_dsi_ursa_720p_video {
		compatible = "qcom,mdss-dsi-panel";
		label = "ursa 720p video mode dsi panel";
		status = "disable";
		qcom,dsi-ctrl-phandle = <&mdss_dsi0>;
		qcom,enable-gpio = <&msmgpio 58 0>;
		qcom,rst-gpio = <&pm8941_gpios 19 0>;
		qcom,mdss-pan-res = <720 1280>;
		qcom,mdss-pan-bpp = <24>;
		qcom,mdss-pan-dest = "display_1";
		/* HBP, HS, HFP, VBP, VS, VFP */
		qcom,mdss-pan-porch-values = <32 16 136 3 1 3>;
		qcom,mdss-pan-underflow-clr = <0xff>;
		qcom,mdss-pan-bl-ctrl = "bl_ctrl_wled";
		qcom,mdss-pan-bl-levels = <1 4095>;
		qcom,mdss-pan-dsi-mode = <0>;
		qcom,mdss-pan-dsi-h-pulse-mode = <0>;
		qcom,mdss-pan-dsi-h-power-stop = <0 1 0>;
		qcom,mdss-pan-dsi-bllp-power-stop = <1 1>;
		qcom,mdss-pan-dsi-traffic-mode = <1>;
		qcom,mdss-pan-dsi-dst-format = <3>;
		qcom,mdss-pan-dsi-vc = <0>;
		qcom,mdss-pan-dsi-rgb-swap = <0>;
		qcom,mdss-pan-dsi-data-lanes = <1 1 1 1>;
		qcom,mdss-pan-dsi-dlane-swap = <0>;
		qcom,mdss-pan-dsi-t-clk = <0x15 0x01>; /* T_CLK_PRE, POST */
		qcom,mdss-pan-dsi-stream = <0>;
		qcom,mdss-pan-dsi-mdp-tr = <0x0>;
		qcom,mdss-pan-dsi-dma-tr = <0x04>;
		qcom,mdss-pan-frame-rate = <60>;
		qcom,panel-phy-regulatorSettings = [03 01 01 00  /* Regulator settings, DSI_BASE+0x580-587 */
						    20 00 01]; /* Using the same settings as CDP for now */
		qcom,panel-phy-timingSettings = [ 76 1B 11 00 3C 45 14 20 1E 03 04 00 ];/* 0x0440 phy timing ctrl 0 - 11 */
		qcom,panel-phy-strengthCtrl = [77 06]; /* left unchanged from CDP */
		qcom,panel-phy-bistCtrl = [00 00 b1 ff           /* BIST Ctrl settings */
					   00 00];
		qcom,panel-phy-laneConfig = [00 c2 45 00 00 00 00 01 75 /* lane0 config */
					     00 c2 45 00 00 00 00 01 75 /* lane1 config */
					     00 c2 45 00 00 00 00 01 75 /* lane2 config */
					     00 c2 45 00 00 00 00 01 75 /* lane3 config */
					     00 02 45 00 00 00 00 01 97]; /* Clk ln config */

		qcom,panel-on-cmds = [05 01 00 00 78 02 11 00 /*exit sleep*/
					23 01 00 00 0a 02 b0 00 /*mcap off */
					29 01 00 00 00 06  /* panel drive */
						c0 40 02 7f 05 02
                                        23 01 00 00 0a 02 bb 0a /* cabc off */
                                        23 01 00 00 0a 02 b0 03 /* mcap on */
                                        15 01 00 00 0a 02 36 00 /* set address mode, DCS_WRITE1 */
					05 01 00 00 32 02 29 00 /* display on */
					];
		qcom,on-cmds-dsi-state = "DSI_LP_MODE";
		qcom,panel-off-cmds = [05 01 00 00 32 02 28 00
					05 01 00 00 78 02 10 00];
		qcom,off-cmds-dsi-state = "DSI_HS_MODE";
	};
};
