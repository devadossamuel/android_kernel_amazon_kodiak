/* Copyright (c) 2013, The Linux Foundation. All rights reserved.
 *
 * This program is free software; you can redistribute it and/or modify
 * it under the terms of the GNU General Public License version 2 and
 * only version 2 as published by the Free Software Foundation.
 *
 * This program is distributed in the hope that it will be useful,
 * but WITHOUT ANY WARRANTY; without even the implied warranty of
 * MERCHANTABILITY or FITNESS FOR A PARTICULAR PURPOSE.  See the
 * GNU General Public License for more details.
 */

/dts-v1/;

/include/ "msm8974-v2.dtsi"
/include/ "ursa.dtsi"
/include/ "ursa-p1-family.dtsi"

/ {
	model = "Lab 126 Ursa v2 P1";
	compatible = "lab126,ursa", "qcom,msm8974";
	qcom,msm-id = <126 3152 0x20000>;
};

&i2c_0 {
	max8834@4A {
	    compatible = "maxim,max8834";
	    reg = <0x4A>;
	};
};
